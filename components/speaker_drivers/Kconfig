## components/speaker_drivers/Kconfig
```kconfig
menu "Speaker hardware"
config SPEAKER_LCD_ENABLE
 bool "Initialize ST7789 (confirm geometry and wiring first)"
 default n
config SPEAKER_LCD_WIDTH
 int "LCD width"
 range 1 320
 default 240
config SPEAKER_LCD_HEIGHT
 int "LCD height"
 range 1 320
 default 240
config SPEAKER_LCD_X_GAP
 int "Column offset"
 range 0 320
 default 0
config SPEAKER_LCD_Y_GAP
 int "Row offset"
 range 0 320
 default 0
config SPEAKER_LCD_INVERT
 bool "Invert panel colors"
 default n
endmenu
```

## components/speaker_service/Kconfig
```kconfig
menu "Speaker service"
config SPEAKER_BT_NAME
 string "Bluetooth name"
 default "ESP32-Speaker-Lab"
endmenu
```

## sdkconfig.defaults
```kconfig
CONFIG_IDF_TARGET="esp32"
CONFIG_ESPTOOLPY_FLASHSIZE_4MB=y
CONFIG_PARTITION_TABLE_CUSTOM=y
CONFIG_PARTITION_TABLE_CUSTOM_FILENAME="partitions.csv"
CONFIG_BT_ENABLED=y
CONFIG_BT_BLUEDROID_ENABLED=y
CONFIG_BTDM_CTRL_MODE_BR_EDR_ONLY=y
CONFIG_BT_CLASSIC_ENABLED=y
CONFIG_BT_A2DP_ENABLE=y
# CONFIG_BT_A2DP_USE_EXTERNAL_CODEC is not set
CONFIG_COMPILER_OPTIMIZATION_SIZE=y
```
